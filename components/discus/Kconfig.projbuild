## components/discus/Kconfig.projbuild
```kconfig
menu "discus"

    menu "Indicator"

        menu "System"
            
        choice DC_LED_INDICATOR_SYSTEM_TYPE
            prompt "Indicator type for System Status LED"
            default DC_LED_INDICATOR_SYSTEM_TYPE_RMT

            config DC_LED_INDICATOR_SYSTEM_TYPE_RMT
                bool "RMT"

            config DC_LED_INDICATOR_SYSTEM_TYPE_RGB
                bool "RBG GPIO"

            config DC_LED_INDICATOR_SYSTEM_TYPE_DISABLED
                bool "Disabled"
        endchoice

        config DC_LED_INDICATOR_SYSTEM_RMT_GPIO
            int "System indicator RMT GPIO"
            depends on DC_LED_INDICATOR_SYSTEM_TYPE_RMT
            default 8
        
        config DC_LED_INDICATOR_SYSTEM_RGB_GPIO_R
            int "System indicator GPIO Red"
            depends on DC_LED_INDICATOR_SYSTEM_TYPE_RGB

        config DC_LED_INDICATOR_SYSTEM_RGB_GPIO_G
            int "System indicator GPIO Green"
            depends on DC_LED_INDICATOR_SYSTEM_TYPE_RGB

        config DC_LED_INDICATOR_SYSTEM_RGB_GPIO_B
            int "System indicator GPIO Blue"
            depends on DC_LED_INDICATOR_SYSTEM_TYPE_RGB
        
        endmenu

        menu "Zigbee"
            choice DC_LED_INDICATOR_ZIGBEE_TYPE
                prompt "Indicator type for Zigbee Status LED"
                default DC_LED_INDICATOR_ZIGBEE_TYPE_RGB

                config DC_LED_INDICATOR_ZIGBEE_TYPE_RMT
                    bool "RMT"

                config DC_LED_INDICATOR_ZIGBEE_TYPE_RGB
                    bool "RBG GPIO"
                
                config DC_LED_INDICATOR_ZIGBEE_TYPE_DISABLED
                    bool "Disabled"
            endchoice

            config DC_LED_INDICATOR_ZIGBEE_RMT_GPIO
                int "Zigbee indicator RMT GPIO"
                depends on DC_LED_INDICATOR_ZIGBEE_TYPE_RMT
            
            config DC_LED_INDICATOR_ZIGBEE_RGB_GPIO_R
                int "Zigbee indicator GPIO Red"
                depends on DC_LED_INDICATOR_ZIGBEE_TYPE_RGB
                default 0

            config DC_LED_INDICATOR_ZIGBEE_RGB_GPIO_G
                int "Zigbee indicator GPIO Green"
                depends on DC_LED_INDICATOR_ZIGBEE_TYPE_RGB
                default 11

            config DC_LED_INDICATOR_ZIGBEE_RGB_GPIO_B
                int "Zigbee indicator GPIO Blue"
                depends on DC_LED_INDICATOR_ZIGBEE_TYPE_RGB
                default 10
        endmenu

        config DC_LED_INDICATOR_MAX_VALUE
            int "Max intensity"
            range 0 255
            default 5
    endmenu
endmenu
```

## sdkconfig.defaults
```kconfig
CONFIG_IDF_TARGET="esp32h2"
CONFIG_ZB_ENABLED=y
CONFIG_ZB_SDK_1xx=y
CONFIG_ZB_ZED=y
CONFIG_ZB_RADIO_NATIVE=y


#
# discus
#

#
# Indicator
#

#
# System
#
CONFIG_DC_LED_INDICATOR_SYSTEM_TYPE_RMT=y
# CONFIG_DC_LED_INDICATOR_SYSTEM_TYPE_RGB is not set
# CONFIG_DC_LED_INDICATOR_SYSTEM_TYPE_DISABLED is not set
CONFIG_DC_LED_INDICATOR_SYSTEM_RMT_GPIO=8
# end of System

#
# Zigbee
#
# CONFIG_DC_LED_INDICATOR_ZIGBEE_TYPE_RMT is not set
CONFIG_DC_LED_INDICATOR_ZIGBEE_TYPE_RGB=y
# CONFIG_DC_LED_INDICATOR_ZIGBEE_TYPE_DISABLED is not set
CONFIG_DC_LED_INDICATOR_ZIGBEE_RGB_GPIO_R=0
CONFIG_DC_LED_INDICATOR_ZIGBEE_RGB_GPIO_G=11
CONFIG_DC_LED_INDICATOR_ZIGBEE_RGB_GPIO_B=10
# end of Zigbee

#
# UART
#
# CONFIG_DC_LED_INDICATOR_UART_TYPE_RMT is not set
CONFIG_DC_LED_INDICATOR_UART_TYPE_RGB=y
# CONFIG_DC_LED_INDICATOR_UART_TYPE_DISABLED is not set
CONFIG_DC_LED_INDICATOR_UART_RGB_GPIO_R=0
CONFIG_DC_LED_INDICATOR_UART_RGB_GPIO_G=11
CONFIG_DC_LED_INDICATOR_UART_RGB_GPIO_B=10
# end of UART

CONFIG_DC_LED_INDICATOR_MAX_VALUE=5
# end of Indicator
# end of discus
```

## src/Kconfig.projbuild
```kconfig
menu "discusFW Configuration"

    menu "WiFi"
        config DC_ESP_USE_WIFI
            bool "Use WiFi"
            default false
            help
                Enable the WiFi feature

        config DC_ESP_WIFI_SSID
            string "WiFi SSID"
            default ""
            depends on DC_ESP_USE_WIFI
            help
                SSID of the target WiFi access point.

        config DC_ESP_WIFI_PASSWORD
            string "WiFi Password"
            default ""
            depends on DC_ESP_USE_WIFI
            help
                Password of the target WiFi access point.

        config DC_ESP_MAXIMUM_RETRY
            int "Maximum WiFi connect retries"
            default 5
            range 0 100
            depends on DC_ESP_USE_WIFI
            help
                Number of reconnection attempts before giving up.

        choice DC_ESP_WIFI_AUTH_THRESHOLD
            prompt "WiFi authmode threshold"
            default DC_ESP_WIFI_AUTH_WPA2_PSK
            depends on DC_ESP_USE_WIFI

            config DC_ESP_WIFI_AUTH_OPEN
                bool "OPEN"

            config DC_ESP_WIFI_AUTH_WEP
                bool "WEP"

            config DC_ESP_WIFI_AUTH_WPA_PSK
                bool "WPA-PSK"

            config DC_ESP_WIFI_AUTH_WPA2_PSK
                bool "WPA2-PSK"

            config DC_ESP_WIFI_AUTH_WPA_WPA2_PSK
                bool "WPA/WPA2-PSK"

            config DC_ESP_WIFI_AUTH_WPA3_PSK
                bool "WPA3-PSK"

            config DC_ESP_WIFI_AUTH_WPA2_WPA3_PSK
                bool "WPA2/WPA3-PSK"

            config DC_ESP_WIFI_AUTH_WAPI_PSK
                bool "WAPI-PSK"
        endchoice

        choice DC_ESP_STATION_WPA3_SAE_PWE_MODE
            prompt "WPA3 SAE PWE mode"
            default DC_ESP_STATION_WPA3_SAE_PWE_HUNT_AND_PECK

            config DC_ESP_STATION_WPA3_SAE_PWE_HUNT_AND_PECK
                bool "Hunt and Peck"

            config DC_ESP_STATION_WPA3_SAE_PWE_HASH_TO_ELEMENT
                bool "Hash to Element (H2E)"

            config DC_ESP_STATION_WPA3_SAE_PWE_BOTH
                bool "Both"
        endchoice

        config DC_ESP_WIFI_PW_ID
            string "WPA3 SAE H2E identifier"
            default ""
            depends on DC_ESP_STATION_WPA3_SAE_PWE_HASH_TO_ELEMENT || DC_ESP_STATION_WPA3_SAE_PWE_BOTH
            help
                Optional password identifier for WPA3 SAE H2E.
    endmenu
    

    menu "MQTT"
        config DC_MQTT_BROKER_URI
            string "MQTT Broker URI"
            default "mqtt://broker.local"
            help
                MQTT broker URI.

        config DC_MQTT_HEARTBEAT_INTERVAL_MS
            int "MQTT heartbeat interval (ms)"
            default 10000
            range 1000 3600000
            help
                Interval between heartbeat publications.
    endmenu

    menu "Indicator"
        choice DC_INDICATOR_TYPE
            prompt "Indicator type"
            default DC_INDICATOR_TYPE_GPIO_RGB

            config DC_INDICATOR_TYPE_GPIO_RGB
                bool "GPIO_RGB"

            config DC_INDICATOR_TYPE_GPIO_SINGLE
                bool "GPIO_SINGLE (Not supported for now)"
                depends on BROKEN
        endchoice

        config DC_ESP_INDICATOR_GPIO_R
            int "Indicator GPIO Red"
            default 0
            depends on DC_INDICATOR_TYPE_GPIO_RGB
            help
                GPIO Pin for the RED indicator leds

        config DC_ESP_INDICATOR_GPIO_G
            int "Indicator GPIO Green"
            default 0
            depends on DC_INDICATOR_TYPE_GPIO_RGB
            help
                GPIO Pin for the GREEN indicator led

        config DC_ESP_INDICATOR_GPIO_B
            int "Indicator GPIO Blue"
            default 0
            depends on DC_INDICATOR_TYPE_GPIO_RGB
            help
                GPIO Pin for the BLUE indicator led
    endmenu
endmenu
```
